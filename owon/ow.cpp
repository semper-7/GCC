#include <avr/io.h>
#include <avr/interrupt.h>
#include <avr/pgmspace.h>
#include <util/delay.h>
#include <string.h>
#include "../lib/delay.h"
#include "../lib/usart.h"
#include "../lib/OneWire.h"

#define DC (F_CPU/4000000UL)
#define DSPIN	2//PC2

int main (void); 
typedef uint8_t byte;
typedef uint16_t word;
OneWire ds (1<<DSPIN);
typedef const uint8_t DeviceAddress[8];
DeviceAddress rom[10] = {
{0x28,0x13,0x39,0x0E,0x06,0x00,0x00,0xAF},
{0x28,0x8A,0xB8,0x0C,0x06,0x00,0x00,0x89},
{0x28,0xA3,0x98,0x0D,0x06,0x00,0x00,0xDE},
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{0x69,0x5a,0x4b,0x3c,0x2d,0x1e,0x0f,0x33},
};
byte p = 3;
byte bufData[9];

int main (void) {
timer0init();
UsartInit(9600);
delay(500);
UsartPrintPGM(PSTR("\r\n1WIRE started\r\n"));
if (!ds.reset()) UsartPrintPGM(PSTR("No 1WIRE sensors!\r\n"));
delay(500);

loop:
ds.reset();
ds.write(0xCC);
ds.write(0x44);
delay(800);
 for (int i=0; i<9; i++) {
 ds.reset();
 ds.select(rom[i]);
 ds.write(0xBE);
 ds.read_bytes(bufData, 9);
//  UsartPrint((const char*)rom + i*8, 8);
//  UsartPrint("\r\n");
 }
delay(300);
ds.reset();
ds.select(rom[9]);
ds.write(p+0x6c);
p=(p+1)&3;
delay(2000);
goto loop;
}
